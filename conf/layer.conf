## conf/layer.conf
```bitbake
# We have a conf and classes directory, add to BBPATH
BBPATH =. "${LAYERDIR}:"

# We have recipes-* directories, add to BBFILES
BBFILES += "${LAYERDIR}/recipes-*/*/*.bb \
            ${LAYERDIR}/recipes-*/*/*.bbappend"

BBFILE_COLLECTIONS += "cdh"
BBFILE_PATTERN_cdh = "^${LAYERDIR}/"
BBFILE_PRIORITY_cdh = "5"

# This should only be incremented on significant changes that will
# cause compatibility issues with other layers
LAYERVERSION_cdh = "1"

LAYERDEPENDS_cdh = "core"
```
